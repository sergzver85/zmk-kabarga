## config/boards/shields/kabarga/Kconfig.defconfig
```kconfig
# Copyright (c) 2020 The ZMK Contributors
# SPDX-License-Identifier: MIT

if SHIELD_KABARGA

config ZMK_KEYBOARD_NAME
	default "KABARGA"

config ZMK_SPLIT
	default n
	
if ZMK_RGB_UNDERGLOW

config ZMK_RGB_UNDERGLOW_EXT_POWER
    default y

config ZMK_RGB_UNDERGLOW_BRT_MAX
    default 50

config ZMK_RGB_UNDERGLOW_ON_START
    default n

config ZMK_RGB_UNDERGLOW_AUTO_OFF_IDLE
    default y

config ZMK_RGB_UNDERGLOW_AUTO_OFF_USB
    default y

#ZMK_RGB_UNDERGLOW
endif

endif
```

## config/boards/shields/kabarga/Kconfig.shield
```kconfig
# Copyright (c) 2020 The ZMK Contributors
# SPDX-License-Identifier: MIT

config SHIELD_KABARGA
	def_bool $(shields_list_contains,kabarga)
```

## config/west.yml
```yaml
manifest:
  remotes:
    - name: SplittedSpace
      url-base: https://github.com/SplittedSpace
  projects:
    - name: zmk-firmware
      remote: SplittedSpace
      revision: main
      import: app/west.yml
  self:
    path: config
```
